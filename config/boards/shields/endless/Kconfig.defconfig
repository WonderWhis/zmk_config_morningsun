## config/boards/shields/endless/Kconfig.defconfig
```kconfig
# Copyright (c) 2020 Pete Johanson
# SPDX-License-Identifier: MIT


if SHIELD_MORNINGSUN

config ZMK_KEYBOARD_NAME
	default "endless"

config ZMK_SPLIT_ROLE_CENTRAL
	default y

endif

if SHIELD_MORNINGSUN || SHIELD_EVENINGMOON

config ZMK_SPLIT
	default y

endif
```

## config/boards/shields/morningsun/Kconfig.defconfig
```kconfig
# Copyright (c) 2020 Pete Johanson
# SPDX-License-Identifier: MIT


if SHIELD_MORNINGSUN

config ZMK_KEYBOARD_NAME
	default "endless"

config ZMK_SPLIT_ROLE_CENTRAL
	default y

endif

if SHIELD_MORNINGSUN || SHIELD_EVENINGMOON

config ZMK_SPLIT
	default y

if LVGL

config LV_Z_VDB_SIZE
	default 64

config LV_Z_DPI
	default 148

config LV_Z_BITS_PER_PIXEL
	default 1

choice LV_COLOR_DEPTH
	default LV_COLOR_DEPTH_1
endchoice

endif # LVGL

endif
```

## config/boards/shields/morningsun/Kconfig.shield
```kconfig
# Copyright (c) 2020 Pete Johanson
# SPDX-License-Identifier: MIT

config SHIELD_MORNINGSUN
    def_bool $(shields_list_contains,morningsun)

config SHIELD_EVENINGMOON
    def_bool $(shields_list_contains,eveningmoon)
```
